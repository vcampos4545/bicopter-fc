## firmware/main/Kconfig.projbuild
```kconfig
menu "Bicopter operating mode"

    choice BICOPTER_OPERATING_MODE
        prompt "Operating mode"
        default BICOPTER_OPERATING_MODE_SIMULATION
        help
            Milestone 18 (see docs/bench_test.md) - a single, build-time-selected mode for the
            whole firmware image, chosen as a Kconfig choice rather than a runtime-switchable
            value specifically to rule out mode-confusion at runtime (e.g. a stale radio packet or
            a bug flipping the running vehicle into HARDWARE_TEST's relaxed motor path mid-flight)
            - see docs/bench_test.md's "Why build-time, not boot-time-latched" section for the
            full safety rationale. Changing mode means reflashing, which is the point.

        config BICOPTER_OPERATING_MODE_SIMULATION
            bool "SIMULATION - development default, no real actuator output expected"
            help
                The safe default for day-to-day firmware development, CI, and QEMU boot
                verification: nothing about this mode assumes real actuator hardware is attached
                (CONFIG_BICOPTER_ACTUATORS_ENABLED normally stays off alongside it, same as every
                other not-yet-wired hardware option in this project). The bench-test console's
                read-only sensor/radio streaming commands still work in this mode; servo/esc_test
                commands work only if actuators are separately enabled. Not to be confused with
                simulator/ (the desktop physics simulator) - this mode governs firmware/, and does
                not itself simulate anything; see docs/bench_test.md.

        config BICOPTER_OPERATING_MODE_HARDWARE_TEST
            bool "HARDWARE_TEST - bench bring-up: individual actuator/sensor test commands, motor test gated"
            help
                For bringing up real hardware on the bench per docs/bench_test.md's recommended
                sequence. Unlocks the bench-test console's esc_test command (motor spin, gated
                behind an explicit CONFIRM token distinct from the normal arm sequence - see
                docs/bench_test.md). The normal flight arm/throttle path is unaffected by this
                choice; combine with CONFIG_BICOPTER_BENCH_TEST_MOTORS_DISABLED for a
                belt-and-suspenders bench session where even a confirmed esc_test cannot spin a
                motor.

        config BICOPTER_OPERATING_MODE_FLIGHT
            bool "FLIGHT - normal operation"
            help
                Normal flight operation: the arming/failsafe state machine (firmware/components/
                safety/) and, once a future milestone wires it in, the real control-allocation
                actuator path. The bench-test console's esc_test and servo commands are refused in
                this mode (see docs/bench_test.md) - bypassing the control loop or spinning a
                motor from a diagnostic console has no legitimate use in a flight build. Read-only
                sensor/radio streaming commands remain available for in-flight diagnostics.
    endchoice

endmenu

menu "Bicopter bench-test tooling"

    config BICOPTER_BENCH_TEST_MOTORS_DISABLED
        bool "BENCH_TEST build: permanently disable motor PWM output at compile time"
        default n
        help
            The BENCH_TEST build configuration required by Milestone 18 (docs/bench_test.md).
            When set, firmware/components/actuators/src/pwm_esc_output.c compiles out - via #if,
            not a runtime check - both the LEDC channel/timer configuration that would attach the
            ESC PWM signal to its GPIO and the single call site that ever updates that channel's
            duty cycle. No code path in this build can produce a motor-spinning PWM signal,
            regardless of what throttle value any caller (including a confirmed HARDWARE_TEST-mode
            esc_test command, or a real control-allocation path once one is wired) requests. Tilt
            servos are unaffected - this only disables the ESC/motor driver. See
            docs/bench_test.md for exactly what is and isn't covered by this guarantee.

    config BICOPTER_BENCH_TEST_CONSOLE_UART_PORT
        int "Bench-test console UART port (0, 1, or 2)"
        default 2
        help
            Deliberately defaults to UART2, distinct from UART0 (logging/programming) and CRSF's
            own default of UART1 (see the CRSF radio menu above), so the bench-test console can run
            concurrently with logging and, if ever needed, a CRSF receiver without contending for
            the same UART. Placeholder, not verified against any actual board wiring - see
            docs/hardware.md.

    config BICOPTER_BENCH_TEST_CONSOLE_RX_GPIO
        int "Bench-test console UART RX GPIO"
        default 4
        help
            Placeholder default, not verified against any actual board wiring - see
            docs/hardware.md.

    config BICOPTER_BENCH_TEST_CONSOLE_TX_GPIO
        int "Bench-test console UART TX GPIO"
        default 2
        help
            Placeholder default, not verified against any actual board wiring - see
            docs/hardware.md.

    config BICOPTER_BENCH_TEST_CONSOLE_BAUD_RATE
        int "Bench-test console UART baud rate"
        default 115200

    config BICOPTER_BENCH_TEST_ESC_MAX_THROTTLE_PERCENT
        int "esc_test command: maximum allowed throttle (percent, 0-100)"
        default 15
        range 0 100
        help
            A hard ceiling the bench-test console's esc_test command clamps every request to,
            independent of (and in addition to) the ESC driver's own min_throttle/max_throttle
            clamp - the design brief's "specific low throttle value" requirement, enforced in
            software rather than left to whatever value an operator happens to type. 15% is a
            conservative placeholder for "visibly spinning but not aggressive," not derived from
            any specific ESC/motor combination - lower it further for an untested prop/motor pair.

    config BICOPTER_BENCH_TEST_ESC_TEST_DURATION_MS
        int "esc_test command: auto-return-to-idle duration (ms)"
        default 2000
        help
            esc_test commands the clamped throttle for exactly this long, then automatically calls
            motor_output_set_idle() and logs that it did - a confirmed esc_test can never leave a
            motor spinning indefinitely because an operator forgot a second "stop" command. See
            docs/bench_test.md.

endmenu

menu "Bicopter actuator hardware (ESC + servo)"

    config BICOPTER_ACTUATORS_ENABLED
        bool "Motor ESCs and tilt servos are wired to this board"
        default n
        help
            No ESP32 board/pinout has been finalized for this project yet (see docs/hardware.md),
            same status as CONFIG_BICOPTER_SENSORS_ENABLED. Leave disabled until a board is chosen
            and the pins below are set to match it. While disabled, main() does not call
            actuators_init_safe() and the bench-test console's servo/esc_test commands report
            "actuators not initialized" instead of attempting to drive a GPIO nothing is connected
            to.

    config BICOPTER_ACTUATOR_PWM_FREQ_HZ
        int "ESC/servo PWM frequency (Hz)"
        depends on BICOPTER_ACTUATORS_ENABLED
        default 50
        help
            50Hz standard RC PWM, shared by both motor units and both servo units in this
            placeholder config - see docs/hardware.md#pwm-esc--tilt-servo-milestone-5 for why LEDC
            over MCPWM and where a BLHeli ESC's real tolerance for a higher rate would be
            determined.

    config BICOPTER_ACTUATOR_PWM_DUTY_RESOLUTION_BITS
        int "LEDC duty resolution (bits)"
        depends on BICOPTER_ACTUATORS_ENABLED
        default 16

    config BICOPTER_MOTOR1_GPIO
        int "Motor 1 (ESC) PWM GPIO"
        depends on BICOPTER_ACTUATORS_ENABLED
        default 25
        help
            Placeholder default, not verified against any actual board wiring - see
            docs/hardware.md.

    config BICOPTER_MOTOR2_GPIO
        int "Motor 2 (ESC) PWM GPIO"
        depends on BICOPTER_ACTUATORS_ENABLED
        default 26

    config BICOPTER_SERVO1_GPIO
        int "Servo 1 (tilt) PWM GPIO"
        depends on BICOPTER_ACTUATORS_ENABLED
        default 27

    config BICOPTER_SERVO2_GPIO
        int "Servo 2 (tilt) PWM GPIO"
        depends on BICOPTER_ACTUATORS_ENABLED
        default 14

    config BICOPTER_ESC_MIN_PULSE_US
        int "ESC calibrated min pulse width (us, throttle=0.0)"
        depends on BICOPTER_ACTUATORS_ENABLED
        default 1000
        help
            See docs/hardware.md's ESC calibration section for how this is normally determined on
            real hardware - not calibrated against any real ESC in this environment.

    config BICOPTER_ESC_MAX_PULSE_US
        int "ESC calibrated max pulse width (us, throttle=1.0)"
        depends on BICOPTER_ACTUATORS_ENABLED
        default 2000

    config BICOPTER_ESC_IDLE_PULSE_US
        int "ESC idle pulse width (us) - commanded at safe-init and by set_idle()"
        depends on BICOPTER_ACTUATORS_ENABLED
        default 1000

    config BICOPTER_SERVO_MIN_PULSE_US
        int "Servo calibrated min pulse width (us, min_angle)"
        depends on BICOPTER_ACTUATORS_ENABLED
        default 1000

    config BICOPTER_SERVO_MAX_PULSE_US
        int "Servo calibrated max pulse width (us, max_angle)"
        depends on BICOPTER_ACTUATORS_ENABLED
        default 2000

    config BICOPTER_SERVO_MIN_ANGLE_MILLIRAD
        int "Servo min tilt angle (milliradians)"
        depends on BICOPTER_ACTUATORS_ENABLED
        default -785
        help
            Milliradians (angle_rad * 1000) so this stays an integer Kconfig value - default
            -785 = about -45 degrees. See docs/hardware.md's tilt-servo geometry section.

    config BICOPTER_SERVO_MAX_ANGLE_MILLIRAD
        int "Servo max tilt angle (milliradians)"
        depends on BICOPTER_ACTUATORS_ENABLED
        default 785

    config BICOPTER_SERVO_NEUTRAL_ANGLE_MILLIRAD
        int "Servo neutral tilt angle (milliradians) - commanded at safe-init and by set_neutral()"
        depends on BICOPTER_ACTUATORS_ENABLED
        default 0

endmenu

menu "Bicopter sensor hardware"

    config BICOPTER_SENSORS_ENABLED
        bool "Physical IMU/barometer sensors are wired to this board"
        default n
        help
            No ESP32 board/pinout has been finalized for this project yet (see docs/hardware.md).
            Leave disabled until a board is chosen and the I2C pins below are set to match it -
            SensorTask (firmware/main/sensor_task.c) gracefully skips real sensor I2C init/reads
            while this is disabled, logging a stub reading instead of attempting a bus that
            doesn't exist. Flip this on and fill in the pins below once a board with an MPU6050
            and BMP581 wired up exists.

    config BICOPTER_I2C_PORT
        int "I2C port number"
        depends on BICOPTER_SENSORS_ENABLED
        default 0

    config BICOPTER_I2C_SDA_GPIO
        int "I2C SDA GPIO"
        depends on BICOPTER_SENSORS_ENABLED
        default 21
        help
            Placeholder default (ESP32's commonly-used default I2C SDA pin) - not verified against
            any actual board wiring. Set to match the real board once one is chosen.

    config BICOPTER_I2C_SCL_GPIO
        int "I2C SCL GPIO"
        depends on BICOPTER_SENSORS_ENABLED
        default 22
        help
            Placeholder default (ESP32's commonly-used default I2C SCL pin) - not verified against
            any actual board wiring. Set to match the real board once one is chosen.

    config BICOPTER_I2C_CLOCK_HZ
        int "I2C clock speed (Hz)"
        depends on BICOPTER_SENSORS_ENABLED
        default 400000
        help
            400kHz ("fast mode") - both the MPU6050 and BMP581 support it per their datasheets.

    config BICOPTER_MPU6050_INT_GPIO
        int "MPU6050 data-ready interrupt GPIO (-1 disables, falls back to polling)"
        depends on BICOPTER_SENSORS_ENABLED
        default -1
        help
            See firmware/components/sensors/include/mpu6050.h - GPIO_NUM_NC (-1) makes
            mpu6050_read() poll the INT_STATUS data-ready bit each call instead of blocking on an
            interrupt-fed queue. Set to a real GPIO once the MPU6050's INT pin is wired to one.

endmenu

menu "Bicopter radio (ESP-NOW)"

    config BICOPTER_RADIO_ENABLED
        bool "ESP-NOW radio link is paired with a ground-station peer"
        default n
        help
            No ground-station peer has been paired or tested in this environment yet (no physical
            hardware - see docs/radio.md). Leave disabled until a peer MAC is configured below and
            two real ESP32 boards are available to pair. RadioTask (firmware/main/radio_task.c)
            gracefully skips Wi-Fi/ESP-NOW init while this is disabled, logging a stub cadence
            instead of bringing up a radio link that has nothing to talk to.

    config BICOPTER_RADIO_PEER_MAC
        string "Paired peer MAC address (AA:BB:CC:DD:EE:FF)"
        depends on BICOPTER_RADIO_ENABLED
        default "FF:FF:FF:FF:FF:FF"
        help
            Placeholder broadcast address - replace with the ground-station peer's real MAC once
            one is chosen and paired. See docs/radio.md's pairing procedure.

    config BICOPTER_RADIO_WIFI_CHANNEL
        int "Wi-Fi channel"
        depends on BICOPTER_RADIO_ENABLED
        default 1
        help
            Both peers must be set to the same fixed channel - ESP-NOW rides on the Wi-Fi radio
            without an actual AP association/channel negotiation. Valid range 1-13
            (region-dependent).

    config BICOPTER_RADIO_COMMAND_TIMEOUT_MS
        int "Command staleness timeout (ms)"
        depends on BICOPTER_RADIO_ENABLED
        default 500
        help
            has_command()/get_health().link_alive (firmware/components/radio/include/radio.h)
            report the link lost if no valid command packet is received within this window. 500ms
            is a placeholder, 10x RadioTask's own 20ms/50Hz cycle - see docs/radio.md. The actual
            failsafe *behavior* once the link is considered lost is Milestone 16's job, not this
            option's.

endmenu

menu "Bicopter radio (CRSF RC receiver)"

    config BICOPTER_CRSF_RADIO_ENABLED
        bool "CRSF RC receiver is wired to this board"
        default n
        help
            No RC receiver has been wired or tested in this environment yet (no physical hardware
            - see docs/radio.md). Leave disabled until a receiver is connected to the UART pins
            below. RadioTask (firmware/main/radio_task.c) gracefully skips UART/CRSF init while
            this is disabled, logging a stub cadence instead. Mutually exclusive with
            BICOPTER_RADIO_ENABLED (ESP-NOW): enabling both is a build-time error in
            radio_task.c, since only one radio transport backs RadioTask's single radio_t at a
            time until a real board decides otherwise (Milestone 17).

    config BICOPTER_CRSF_UART_PORT
        int "UART port number"
        depends on BICOPTER_CRSF_RADIO_ENABLED
        default 1
        help
            UART0 is typically reserved for the console/programming interface on most ESP32 dev
            boards - UART1 is a safer placeholder default. Set to match the real board once one is
            chosen.

    config BICOPTER_CRSF_UART_RX_GPIO
        int "CRSF UART RX GPIO (receiver TX wire connects here)"
        depends on BICOPTER_CRSF_RADIO_ENABLED
        default 16
        help
            Placeholder default, not verified against any actual board wiring - see
            docs/hardware.md.

    config BICOPTER_CRSF_UART_TX_GPIO
        int "CRSF UART TX GPIO (-1 disables; unused this milestone)"
        depends on BICOPTER_CRSF_RADIO_ENABLED
        default -1
        help
            CRSF telemetry write-back (this device -> RC receiver -> transmitter) is out of scope
            for Milestone 15 - see docs/radio.md. Left configurable for whenever that follow-up
            lands; -1 leaves the TX pin unconfigured (UART_PIN_NO_CHANGE).

    config BICOPTER_CRSF_BAUD_RATE
        int "CRSF UART baud rate"
        depends on BICOPTER_CRSF_RADIO_ENABLED
        default 420000
        help
            420000 is CRSF's common default; some receiver/transmitter pairs use 400000, 921600,
            or higher - configurable, not hardcoded to one vendor's convention.

    config BICOPTER_CRSF_COMMAND_TIMEOUT_MS
        int "Command staleness timeout (ms)"
        depends on BICOPTER_CRSF_RADIO_ENABLED
        default 200
        help
            has_command()/get_health().link_alive report the link lost if no valid RC_CHANNELS
            frame is received within this window. CRSF links commonly run well under 20ms/frame,
            so 200ms is a shorter placeholder than ESP-NOW's 500ms default - still a placeholder
            pending real hardware measurement (Milestone 17), and still not what happens once the
            link is lost, which is Milestone 16's job.

    config BICOPTER_CRSF_NOMINAL_FRAME_PERIOD_US
        int "Nominal frame period (microseconds), for the packet-loss estimate"
        depends on BICOPTER_CRSF_RADIO_ENABLED
        default 4000
        help
            CRSF carries no sequence number (unlike this project's own ESP-NOW packet format), so
            radio_health_t.packet_loss_percent is estimated from elapsed time against this
            configured nominal period rather than counted from sequence-number gaps - see
            docs/radio.md. Set to roughly match the transmitter's real configured CRSF update rate
            once known; a wrong value only makes this figure meaningless, it never affects
            link_alive/staleness detection.

    config BICOPTER_CRSF_THROTTLE_CHANNEL
        int "Throttle channel index (0-15)"
        depends on BICOPTER_CRSF_RADIO_ENABLED
        default 0

    config BICOPTER_CRSF_ROLL_CHANNEL
        int "Roll channel index (0-15)"
        depends on BICOPTER_CRSF_RADIO_ENABLED
        default 1

    config BICOPTER_CRSF_PITCH_CHANNEL
        int "Pitch channel index (0-15)"
        depends on BICOPTER_CRSF_RADIO_ENABLED
        default 2

    config BICOPTER_CRSF_YAW_CHANNEL
        int "Yaw channel index (0-15)"
        depends on BICOPTER_CRSF_RADIO_ENABLED
        default 3

    config BICOPTER_CRSF_ARM_CHANNEL
        int "Arm-switch channel index (0-15)"
        depends on BICOPTER_CRSF_RADIO_ENABLED
        default 4

    config BICOPTER_CRSF_FLIGHT_MODE_CHANNEL
        int "Flight-mode-switch channel index (0-15)"
        depends on BICOPTER_CRSF_RADIO_ENABLED
        default 5

    config BICOPTER_CRSF_FLIGHT_MODE_POSITIONS
        int "Flight-mode switch position count"
        depends on BICOPTER_CRSF_RADIO_ENABLED
        default 3
        help
            Number of discrete positions to quantize the flight-mode channel into (e.g. 3 for a
            standard 3-position switch). flight_mode is reported as 0..(positions-1).

    config BICOPTER_CRSF_RAW_MIN
        int "Raw channel value at the low endpoint"
        depends on BICOPTER_CRSF_RADIO_ENABLED
        default 172
        help
            172/992/1811 are the de facto CRSF/OpenTX endpoint convention (~988-2012us mapped onto
            an 11-bit raw range) - a reasonable default, not this project asserting it's correct
            for every transmitter. Measure and set the real endpoints for the actual TX/RX pair
            once hardware exists - see docs/radio.md's calibration procedure.

    config BICOPTER_CRSF_RAW_CENTER
        int "Raw channel value at center/neutral"
        depends on BICOPTER_CRSF_RADIO_ENABLED
        default 992

    config BICOPTER_CRSF_RAW_MAX
        int "Raw channel value at the high endpoint"
        depends on BICOPTER_CRSF_RADIO_ENABLED
        default 1811

    config BICOPTER_CRSF_ARM_THRESHOLD
        int "Raw channel value at/above which the arm channel reads as armed"
        depends on BICOPTER_CRSF_RADIO_ENABLED
        default 992

endmenu

menu "Bicopter battery monitoring"

    config BICOPTER_BATTERY_ENABLED
        bool "Battery voltage-divider (and optional current-sense) ADC is wired to this board"
        default n
        help
            No battery/voltage-divider hardware has been chosen or wired to this board yet (see
            docs/hardware.md's "Battery cell count / voltage-divider and current-sense scaling:
            TBD" entry). Leave disabled until a divider is built and the ADC channel/ratio below
            are set to match it - SafetyTask (firmware/main/safety_task.c) gracefully skips real
            ADC init/reads while this is disabled. The arming precondition battery_ok fails closed
            (reports false, blocking arming) while this is disabled, same as imu_valid/
            radio_link_alive do when their own hardware/link is absent - a missing signal is never
            treated as "ok," see docs/safety.md.

    config BICOPTER_BATTERY_ADC_UNIT
        int "ADC unit (1 or 2)"
        depends on BICOPTER_BATTERY_ENABLED
        default 1
        help
            ESP32 has two SAR ADC units; ADC2 is shared with Wi-Fi and unusable while Wi-Fi is
            active (relevant if ESP-NOW radio is also enabled - see docs/radio.md). Unit 1 is the
            safer default for a board that may also use ESP-NOW.

    config BICOPTER_BATTERY_VOLTAGE_ADC_CHANNEL
        int "Voltage-sense ADC channel"
        depends on BICOPTER_BATTERY_ENABLED
        default 0
        help
            Placeholder default, not verified against any actual board wiring - see
            docs/hardware.md.

    config BICOPTER_BATTERY_ADC_ATTENUATION
        int "ADC attenuation (0=0dB, 1=2.5dB, 2=6dB, 3=12dB)"
        depends on BICOPTER_BATTERY_ENABLED
        default 3
        help
            12dB attenuation gives the ESP32's widest input range (~0-3.1V), the usual choice
            downstream of a voltage divider sized to keep Vadc within that range at the pack's
            maximum voltage.

    config BICOPTER_BATTERY_VOLTAGE_DIVIDER_RATIO_MILLI
        int "Voltage-divider ratio (Vbat/Vadc), x1000"
        depends on BICOPTER_BATTERY_ENABLED
        default 11000
        help
            Placeholder (11.000:1), not derived from any chosen resistor pair - see
            docs/hardware.md's TBD entry and docs/safety.md. Vbat = Vadc * (this value / 1000).
            Set to match the real divider once built: ratio = (R1+R2)/R2 for a divider with R1
            from Vbat to the ADC pin and R2 from the ADC pin to ground.

    config BICOPTER_BATTERY_CELL_COUNT
        int "Battery cell count (S)"
        depends on BICOPTER_BATTERY_ENABLED
        default 3
        help
            Scales the per-cell LOW/CRITICAL thresholds below and the default percentage curve
            (battery_default_single_cell_curve() in battery_convert.c) to the configured pack.

    config BICOPTER_BATTERY_LOW_VOLTAGE_PER_CELL_MV
        int "LOW_BATTERY threshold, millivolts per cell"
        depends on BICOPTER_BATTERY_ENABLED
        default 3500
        help
            A common conservative LiPo per-cell "getting low" rest-voltage figure - not derived
            from any specific cell's datasheet. See docs/safety.md for the full battery-monitoring
            caveat. Multiplied by BICOPTER_BATTERY_CELL_COUNT to get the pack-level threshold.

    config BICOPTER_BATTERY_CRITICAL_VOLTAGE_PER_CELL_MV
        int "CRITICAL_BATTERY threshold, millivolts per cell"
        depends on BICOPTER_BATTERY_ENABLED
        default 3300
        help
            A common conservative LiPo per-cell "must land now" rest-voltage figure - not derived
            from any specific cell's datasheet, and does not account for load-sag (see
            docs/safety.md). Multiplied by BICOPTER_BATTERY_CELL_COUNT to get the pack-level
            threshold.

    config BICOPTER_BATTERY_CURRENT_SENSE_ENABLED
        bool "Current-sense ADC channel is also wired (optional - see docs/safety.md)"
        depends on BICOPTER_BATTERY_ENABLED
        default n
        help
            Voltage monitoring is this milestone's priority; current sensing is supported (a
            second ADC channel through the same linear-scaling conversion path) but not required -
            see AGENTS.md/docs/safety.md. No current-sense shunt/hall-sensor hardware is chosen
            yet.

    config BICOPTER_BATTERY_CURRENT_ADC_CHANNEL
        int "Current-sense ADC channel"
        depends on BICOPTER_BATTERY_CURRENT_SENSE_ENABLED
        default 1

    config BICOPTER_BATTERY_CURRENT_SCALE_MILLIAMPS_PER_VOLT
        int "Current-sense scale, milliamps per volt at the ADC pin"
        depends on BICOPTER_BATTERY_CURRENT_SENSE_ENABLED
        default 40000
        help
            Placeholder (40A/V), not derived from any chosen shunt/hall-sensor part - depends
            entirely on the current-sense hardware eventually chosen (see docs/hardware.md).

endmenu

menu "Bicopter safety / failsafe thresholds"

    config BICOPTER_SAFETY_MAX_TILT_ANGLE_DEG
        int "Maximum tilt-from-level before EXCESSIVE_ATTITUDE failsafe triggers (degrees, 0=disabled)"
        default 60
        help
            Placeholder, not tuned against any real flight envelope (no hardware exists yet - see
            docs/hardware.md). See docs/safety.md. This check cannot currently fire in firmware -
            no estimator runs in firmware yet to supply a real tilt angle (see docs/safety.md's
            "What's wired to live data, and what isn't yet" section) - but is implemented, real,
            and host-tested (failsafe.c / tests/failsafe_test.c), ready for when that wiring lands.

    config BICOPTER_SAFETY_MAX_ANGULAR_RATE_DPS
        int "Maximum body angular rate before EXCESSIVE_ANGULAR_VELOCITY failsafe triggers (deg/s, 0=disabled)"
        default 500
        help
            Placeholder, not tuned against any real flight envelope. Unlike the tilt-angle check
            above, this one DOES have a real firmware signal source: SafetyTask peeks the raw gyro
            rate from SensorTask's sample queue (see docs/safety.md) - no estimator dependency.

    config BICOPTER_SAFETY_STATIONARY_MAX_ANGULAR_RATE_DPS
        int "Maximum body angular rate to consider the vehicle stationary for arming (deg/s, 0=disabled)"
        default 20
        help
            Part of the arming precondition set (arming.h's arming_is_stationary()) - the design
            brief's explicit "check the vehicle is stationary during arming" requirement. Real
            firmware signal source: the same raw gyro peek as the angular-rate failsafe above.

    config BICOPTER_ALTITUDE_HOLD_ENABLED
        bool "Enable the experimental ALTITUDE_HOLD flight mode"
        default n
        help
            ALTITUDE_HOLD is explicitly experimental and disabled/unreachable by default per this
            project's design brief - no barometer-based altitude/vertical-velocity estimator
            exists yet (docs/estimation.md notes this is deferred), so ALTITUDE_HOLD has no real
            control loop behind it even when this gate is enabled. See docs/safety.md. Requesting
            ALTITUDE_HOLD from the radio while this is off is a documented no-op in
            flight_mode.c, not an error.

endmenu
```
